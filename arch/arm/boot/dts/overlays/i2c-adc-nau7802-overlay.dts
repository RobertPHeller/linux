// Definitions for Nuvoton NUA7802 I2C 24-Bit Dual-Channel ADC controller on ARM I2C bus.
/dts-v1/;
/plugin/;

/{
	compatible = "brcm,bcm2835";

	fragment@0 {
		target = <&i2c_arm>;
		__overlay__ {
			#address-cells = <1>;
			#size-cells = <0>;
			status = "okay";

			nau: nau@2a {
				compatible = "nuvoton,nau7802";
				reg = <0x2a>;
				status = "okay";
			};
		};
	};
};
